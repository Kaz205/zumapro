## Documentation/devicetree/bindings/media/i2c/giantec,gt9769.yaml
```yaml
# SPDX-License-Identifier: (GPL-2.0 OR BSD-2-Clause)
# Copyright (c) 2020 MediaTek Inc.
%YAML 1.2
---
$id: http://devicetree.org/schemas/media/i2c/giantec,gt9769.yaml#
$schema: http://devicetree.org/meta-schemas/core.yaml#

title: Giantec Semiconductor, Crop. GT9768 & GT9769 Voice Coil Motor (VCM)

maintainers:
  - Zhi Mao <zhi.mao@mediatek.com>

description: |-
  The Giantec GT9768 & GT9768 is a 10-bit DAC with current sink capability.
  The DAC is controlled via I2C bus that operates at clock rates up to 1MHz.
  This chip integrates Advanced Actuator Control (AAC) technology
  and is intended for driving voice coil lens in camera modules.

properties:
  compatible:
    enum:
      - giantec,gt9768
      - giantec,gt9769

  reg:
    maxItems: 1

  vin-supply: true

  vdd-supply: true

required:
  - compatible
  - reg
  - vin-supply
  - vdd-supply

additionalProperties: false

examples:
  - |

    i2c {
        #address-cells = <1>;
        #size-cells = <0>;

        camera-lens@c {
            compatible = "giantec,gt9769";
            reg = <0x0c>;

            vin-supply = <&gt97xx_vin>;
            vdd-supply = <&gt97xx_vdd>;
        };
    };

...
```

## Documentation/devicetree/bindings/media/mediatek-aie.yaml
```yaml
# SPDX-License-Identifier: (GPL-2.0-only OR BSD-2-Clause)
# Copyright (c) 2023 MediaTek Inc.

%YAML 1.2
---
$id: "http://devicetree.org/schemas/media/mediatek-aie.yaml#"
$schema: "http://devicetree.org/meta-schemas/core.yaml#"

title: The AIE Unit of Mediatek Camera System

maintainers:
  -  MTK ISD <copy.chou@mediatek.com>

description:
  MediaTek AIE is the ISP unit in MediaTek SoC.

properties:
  compatible:
    const: mt8188-aie

  "#address-cells":
    const: 2

  "#size-cells":
    const: 2

  power-domains:
    maxItems: 1

  iommus:
    description:
      Points to the respective IOMMU block with master port as argument, see
      Documentation/devicetree/bindings/iommu/mediatek,iommu.yaml for details.
      Ports are according to the HW.

required:
  - compatible
  - reg
  - interrupts
  - dma-ranges
  - iommus
  - power-domains
  - clocks
  - clock-names

additionalProperties: false

examples:
  - |
aie@15310000:
  compatible: ["mediatek,mt8188-aie", "mediatek,aie-hw3.1", "mediatek,aie-hw3.0"]
  reg: [0, 0x15310000, 0, 0x1000]
  interrupts: [GIC_SPI, 787, IRQ_TYPE_LEVEL_HIGH, 0]
  mediatek,larb: ["&larb12"]
  dma-ranges: [0x2, 0x0, 0x0, 0x40000000, 0x1, 0x0]
  iommus:
    - "&vpp_iommu M4U_PORT_L12_FDVT_RDA_0"
    - "&vpp_iommu M4U_PORT_L12_FDVT_RDB_0"
    - "&vpp_iommu M4U_PORT_L12_FDVT_WRA_0"
    - "&vpp_iommu M4U_PORT_L12_FDVT_WRB_0"
  power-domains: ["&spm MT8188_POWER_DOMAIN_IPE"]
  clocks:
    - "&imgsys CLK_IMGSYS_MAIN_IPE"
    - "&ipesys CLK_IPE_FDVT"
    - "&ipesys CLK_IPE_SMI_LARB12"
    - "&ipesys CLK_IPESYS_TOP"
  clock-names:
    - "IMG_IPE"
    - "IPE_FDVT"
    - "IPE_SMI_LARB12"
    - "IPE_TOP"
  operating-points-v2: ["&opp_table_ipe"]
  dvfsrc-vcore-supply: ["&vmm_proxy_label"]

...
```

## Documentation/devicetree/bindings/media/mediatek/mediatek,cam-raw.yaml
```yaml
# SPDX-License-Identifier: (GPL-2.0-only OR BSD-2-Clause)
# Copyright (c) 2023 MediaTek Inc.

%YAML 1.2
---
$id: "http://devicetree.org/schemas/media/mediatek,cam-raw.yaml#"
$schema: "http://devicetree.org/meta-schemas/core.yaml#"

title: The cam-raw unit of Mediatek ISP system

maintainers:
  - MTK ISD <MTK_ISD_SW2@mediatek.com>

description:
  MediaTek cam-raw is the ISP Pass1 unit in MediaTek SoC.

properties:
  compatible:
    const: mediatek,cam-raw

  "#address-cells":
    const: 2

  "#size-cells":
    const: 2

  ranges: true

  power-domains:
    maxItems: 1

  iommus:
    description:
      Points to the respective IOMMU block with master port as argument, see
      Documentation/devicetree/bindings/iommu/mediatek,iommu.yaml for details.
      Ports are according to the HW.

required:
  - compatible
  - reg
  - reg-names
  - ranges
  - interrupts
  - power-domains
  - clocks
  - clock-names
  - iommus

additionalProperties: false

examples:
  - |
    cam_raw_a@16030000 {
      compatible = "mediatek,cam-raw";
      reg = <0 0x16030000 0 0x8000>,
            <0 0x16038000 0 0x8000>;
      reg-names = "base", "inner_base";
      mediatek,cam-id = <0>;
      mediatek,larbs = <&larb16a>;
      interrupts = <GIC_SPI 300 IRQ_TYPE_LEVEL_HIGH 0>;
      dma-ranges = <0x2 0x0 0x0 0x40000000 0x1 0x0>;
      power-domains = <&spm MT8188_POWER_DOMAIN_CAM_SUBA>;
      clocks = <&camsys CLK_CAM_MAIN_CAM2MM0_GALS>,
          <&camsys CLK_CAM_MAIN_CAM2MM1_GALS>,
          <&camsys CLK_CAM_MAIN_CAM2SYS_GALS>,
          <&camsys CLK_CAM_MAIN_CAM>,
          <&camsys CLK_CAM_MAIN_CAMTG>,
          <&camsys_rawa CLK_CAM_RAWA_LARBX>,
          <&camsys_rawa CLK_CAM_RAWA_CAM>,
          <&camsys_rawa CLK_CAM_RAWA_CAMTG>,
          <&topckgen CLK_TOP_CAM>,
          <&topckgen CLK_TOP_CAMTG>,
          <&topckgen CLK_TOP_CAMTM>;
      clock-names = "camsys_cam2mm0_cgpdn",
          "camsys_cam2mm1_cgpdn",
          "camsys_cam2sys_cgpdn",
          "camsys_cam_cgpdn",
          "camsys_camtg_cgpdn",
          "camsys_rawa_larbx_cgpdn",
          "camsys_rawa_cam_cgpdn",
          "camsys_rawa_camtg_cgpdn",
          "topckgen_top_cam",
          "topckgen_top_camtg",
          "topckgen_top_camtm";
      assigned-clocks = <&topckgen CLK_TOP_CAM>;
      assigned-clock-parents = <&topckgen CLK_TOP_UNIVPLL_D5>;
      iommus = <&vpp_iommu M4U_PORT_L16A_IMGO_R1>,
          <&vpp_iommu M4U_PORT_L16A_CQI_R1>,
          <&vpp_iommu M4U_PORT_L16A_CQI_R2>,
          <&vpp_iommu M4U_PORT_L16A_BPCI_R1>,
          <&vpp_iommu M4U_PORT_L16A_LSCI_R1>,
          <&vpp_iommu M4U_PORT_L16A_RAWI_R2>,
          <&vpp_iommu M4U_PORT_L16A_RAWI_R3>,
          <&vpp_iommu M4U_PORT_L16A_UFDI_R2>,
          <&vpp_iommu M4U_PORT_L16A_UFDI_R3>,
          <&vpp_iommu M4U_PORT_L16A_RAWI_R4>,
          <&vpp_iommu M4U_PORT_L16A_RAWI_R5>,
          <&vpp_iommu M4U_PORT_L16A_AAI_R1>,
          <&vpp_iommu M4U_PORT_L16A_UFDI_R5>,
          <&vpp_iommu M4U_PORT_L16A_FHO_R1>,
          <&vpp_iommu M4U_PORT_L16A_AAO_R1>,
          <&vpp_iommu M4U_PORT_L16A_TSFSO_R1>,
          <&vpp_iommu M4U_PORT_L16A_FLKO_R1>;
    };

...
```

## Documentation/devicetree/bindings/media/mediatek/mediatek,cam-yuv.yaml
```yaml
# SPDX-License-Identifier: (GPL-2.0-only OR BSD-2-Clause)
# Copyright (c) 2023 MediaTek Inc.

%YAML 1.2
---
$id: "http://devicetree.org/schemas/media/mediatek,cam-yuv.yaml#"
$schema: "http://devicetree.org/meta-schemas/core.yaml#"

title: The cam-yuv unit of Mediatek ISP system

maintainers:
  - MTK ISD <MTK_ISD_SW2@mediatek.com>

description:
  MediaTek cam-yuv is the ISP Pass1 unit in MediaTek SoC.

properties:
  compatible:
    const: mediatek,cam-yuv

  "#address-cells":
    maxItems: 2

  "#size-cells":
    maxItems: 2

  ranges: true

  power-domains:
    maxItems: 1

  iommus:
    description:
      Points to the respective IOMMU block with master port as argument, see
      Documentation/devicetree/bindings/iommu/mediatek,iommu.yaml for details.
      Ports are according to the HW.

required:
  - compatible
  - reg
  - reg-names
  - ranges
  - interrupts
  - power-domains
  - clocks
  - clock-names
  - iommus

additionalProperties: false

examples:
  - |
    cam_yuv_b@16090000 {
      compatible = "mediatek,cam-yuv";
      reg = <0 0x16090000 0 0x8000>;
      reg-names = "base";
      mediatek,cam-id = <1>;
      mediatek,larbs = <&larb17b>;
      interrupts = <GIC_SPI 303 IRQ_TYPE_LEVEL_HIGH 0>;
      dma-ranges = <0x2 0x0 0x0 0x40000000 0x1 0x0>;
      power-domains = <&spm MT8188_POWER_DOMAIN_CAM_SUBB>;
      clocks = <&camsys CLK_CAM_MAIN_CAM2MM0_GALS>,
          <&camsys CLK_CAM_MAIN_CAM2MM1_GALS>,
          <&camsys CLK_CAM_MAIN_CAM2SYS_GALS>,
          <&camsys_yuvb CLK_CAM_YUVB_LARBX>,
          <&camsys_yuvb CLK_CAM_YUVB_CAM>,
          <&camsys_yuvb CLK_CAM_YUVB_CAMTG>;
      clock-names = "camsys_cam2mm0_cgpdn",
          "camsys_cam2mm1_cgpdn",
          "camsys_cam2sys_cgpdn",
          "camsys_yuvb_larbx_cgpdn",
          "camsys_yuvb_cam_cgpdn",
          "camsys_yuvb_camtg_cgpdn";
      assigned-clocks = <&topckgen CLK_TOP_CAM>;
      assigned-clock-parents = <&topckgen CLK_TOP_UNIVPLL_D5>;
      iommus = <&vdo_iommu M4U_PORT_L17B_YUVO_R1>,
           <&vdo_iommu M4U_PORT_L17B_YUVO_R3>,
           <&vdo_iommu M4U_PORT_L17B_YUVCO_R1>,
           <&vdo_iommu M4U_PORT_L17B_YUVO_R2>,
           <&vdo_iommu M4U_PORT_L17B_RZH1N2TO_R1>,
           <&vdo_iommu M4U_PORT_L17B_DRZS4NO_R1>,
           <&vdo_iommu M4U_PORT_L17B_TNCSO_R1>;
    };

...
```

## Documentation/devicetree/bindings/media/mediatek/mediatek,camisp.yaml
```yaml
# SPDX-License-Identifier: (GPL-2.0-only OR BSD-2-Clause)
# Copyright (c) 2023 MediaTek Inc.

%YAML 1.2
---
$id: "http://devicetree.org/schemas/media/mediatek,camisp.yaml#"
$schema: "http://devicetree.org/meta-schemas/core.yaml#"

title: The camisp unit of Mediatek ISP system

maintainers:
  - MTK ISD <MTK_ISD_SW2@mediatek.com>

description:
  MediaTek camisp is the ISP auxiliary hardware unit in MediaTek SoC.

properties:
  compatible:
    const: mediatek,camisp

  "#address-cells":
    maxItems: 2

  "#size-cells":
    maxItems: 2

  ranges: true

  power-domains:
    maxItems: 1

required:
  - compatible
  - reg
  - reg-names
  - ranges
  - power-domains

additionalProperties: false

examples:
  - |
    camisp: camisp@16000000 {
      compatible = "mediatek,camisp";
      reg = <0 0x16000000 0 0x1000>;
      reg-names = "base";
      mediatek,scp = <&scp_dual>;
      power-domains = <&spm MT8188_POWER_DOMAIN_CAM_MAIN>;
    };

...
```

## Documentation/devicetree/bindings/media/mediatek/mediatek,seninf-core.yaml
```yaml
# SPDX-License-Identifier: (GPL-2.0-only OR BSD-2-Clause)
# Copyright (c) 2023 MediaTek Inc.

%YAML 1.2
---
$id: "http://devicetree.org/schemas/media/mediatek,seninf-core.yaml#"
$schema: "http://devicetree.org/meta-schemas/core.yaml#"

title: The seninf-core top unit of Mediatek ISP system

maintainers:
  - MTK ISD <MTK_ISD_SW2@mediatek.com>

description:
  MediaTek seninf-core is the ISP sensor interface unit in MediaTek SoC.
  The sensor interface serves as the MIPI-CSI2 top RX controller.

properties:
  compatible:
    const: mediatek,seninf-core

  "#address-cells":
    const: 2

  "#size-cells":
    const: 2

  ranges: true

  power-domains:
    maxItems: 4

required:
  - compatible
  - reg
  - reg-names
  - ranges
  - interrupts
  - power-domains
  - clocks
  - clock-names

additionalProperties: false

examples:
  - |
    seninf_top: seninf_top@16010000 {
      compatible = "mediatek,seninf-core";
      reg = <0 0x16010000 0 0x8000>,
            <0 0x11ed0000 0 0xc000>;
      reg-names = "base", "ana-rx";
      mtk_csi_phy_ver = "mtk_csi_phy_2_0";
      interrupts = <GIC_SPI 316 IRQ_TYPE_LEVEL_HIGH 0>;
      power-domains = <&spm MT8188_POWER_DOMAIN_CSIRX_TOP>,
                      <&spm MT8188_POWER_DOMAIN_CAM_VCORE>,
                      <&spm MT8188_POWER_DOMAIN_CAM_MAIN>;
      clocks = <&camsys CLK_CAM_MAIN_SENINF>,
              <&topckgen CLK_TOP_SENINF>,
              <&topckgen CLK_TOP_SENINF1>,
              <&topckgen CLK_TOP_CAMTM>;
      clock-names = "clk_cam_seninf",
                    "clk_top_seninf",
                    "clk_top_seninf1",
                    "clk_top_camtm";
    };

...
```

## Documentation/devicetree/bindings/media/mediatek/mediatek,seninf.yaml
```yaml
# SPDX-License-Identifier: (GPL-2.0-only OR BSD-2-Clause)
# Copyright (c) 2023 MediaTek Inc.

%YAML 1.2
---
$id: "http://devicetree.org/schemas/media/mediatek,seninf.yaml#"
$schema: "http://devicetree.org/meta-schemas/core.yaml#"

title: The seninf unit of Mediatek ISP system

maintainers:
  - MTK ISD <MTK_ISD_SW2@mediatek.com>

description:
  MediaTek seninf is the MIPI-CSI2 port for seninf-core in MediaTek SoC.
  These ports provide the optional capability to define endpoints and set rx
  parameters for camera sensors.

properties:
  compatible:
    const: mediatek,seninf

required:
  - compatible
  - csi-port

additionalProperties: false

examples:
  - |
    &seninf_top {
      seninf_csi_port_0: seninf_csi_port_0 {
        compatible = "mediatek,seninf";
        csi-port = "0";
        port {
          seninf_csi_port_0_in_1: endpoint {
            data-lanes = <1 2 3 4>;
            link-frequencies = /bits/ 64 <1440000000 624000000>;
            remote-endpoint = <&sensor0_out_1>;
          };
          seninf_csi_port_0_in_2: endpoint@2 {
            data-lanes = <1 2 3 4>;
            link-frequencies = /bits/ 64 <336000000 207000000>;
            remote-endpoint = <&sensor0_out_2>;
          };
        };
      };
    };

...
```

## drivers/media/platform/mediatek/isp/Kconfig
```kconfig
# SPDX-License-Identifier: GPL-2.0-only

config VIDEO_MTK_ISP_71_CAMSYS
	tristate "Mediatek ISP 7.1 camsys driver"
	depends on ARCH_MEDIATEK
	select V4L2_FWNODE
	select VIDEO_V4L2_SUBDEV_API
	select VIDEOBUF2_DMA_CONTIG
	select RPMSG_MTK_CCD
	select MTKCCD_REMOTEPROC
	select MTK_SCP

	default n
	help
		Camsys driver controls 3A (auto-focus, exposure,
		and white balance) with tuning feature and outputs
		the captured image buffers in Mediatek's ISP7 system.

		Choose y if you want to use Mediatek SoCs to create image
		captured application such as video recording and still image
		capturing.

config VIDEO_MTK_ISP_71_IMGSYS
	tristate "Mediatek ISP70 image processing system function"
	depends on MTK_CMDQ
	depends on REMOTEPROC
	select VIDEO_V4L2_SUBDEV_API
	select VIDEOBUF2_DMA_CONTIG
	select VIDEOBUF2_CORE
	select VIDEOBUF2_V4L2
	select VIDEOBUF2_MEMOPS
	select MEDIA_CONTROLLER

	default n
	help
	    Support the basic Image processing system driver.

	    IMGSYS driver provides image format conversion, resizing,
	    and rotation function through the low power hardware.
	    IMGSYS also supports multiple output feature. It can
	    generate two or more output image with different effect
	    based on a single input image at the same time.
```

## drivers/soc/mediatek/apusys/Kconfig
```kconfig
# SPDX-License-Identifier: GPL-2.0-only

config MTK_APUSYS_SUPPORT
	tristate "MediaTek APUSYS driver"
	select REGMAP
	select MAILBOX
	select MTK_APU_MBOX
	select MTK_SCP
	help
	  Enable Mediatek APUSYS feature for centralize control.
	  Middleware and APU scheduler will control memory,
	  QoS, and normal/deadline command queue in central layer.
	  Support multiple, multicore APU command scheduling and
	  execution in low level driver.

config MTK_APUSYS_PM
	tristate "MediaTek APUSYS Power Driver"
	select PM_GENERIC_DOMAINS
	depends on PM
	help
	  Enable Mediatek APU_TOP mtcmos control.
	  Support APU_TOP generic power domain multi-user use.
	  APU RPC HW for power on/off flow control and
	  execution in low level driver.
```
