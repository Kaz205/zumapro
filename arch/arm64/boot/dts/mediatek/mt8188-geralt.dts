// SPDX-License-Identifier: (GPL-2.0 OR MIT)
/*
 * Copyright (C) 2022 MediaTek Inc.
 */
/dts-v1/;
#include "mt8188-geralt.dtsi"
#include "mt8188_geralt_camera_v4l2.dtsi"

/ {
	model = "Google Geralt board";
	compatible = "google,geralt", "mediatek,mt8188";
};
