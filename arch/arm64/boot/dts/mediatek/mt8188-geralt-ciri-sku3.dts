// SPDX-License-Identifier: (GPL-2.0 OR MIT)
/*
 * Copyright 2024 Google LLC
 */
/dts-v1/;
#include "mt8188-geralt-ciri.dtsi"
#include "mt8188-ciri-camera-v4l2.dtsi"

/ {
	model = "Google Ciri sku3 board";
	compatible = "google,ciri-sku3", "google,ciri", "mediatek,mt8188";
};

&panel {
	compatible = "ivo,t109nw41";
};

&touchscreen {
	himax,pid = <0x1003>;
	himax,firmware-name = "himax_i2chid_1003.bin";
	firmware-name = "himax_i2chid_1003.bin";
};
